## software/mods/check-in-beacon-c3/sdkconfig.defaults
```kconfig
# ESP32-C3 mini beacon target.
CONFIG_IDF_TARGET="esp32c3"

# Arduino-as-component: auto-run setup()/loop().
CONFIG_AUTOSTART_ARDUINO=y
CONFIG_FREERTOS_HZ=1000

# Conservative defaults for common ESP32-C3 mini dev boards.
CONFIG_ESPTOOLPY_FLASHSIZE_4MB=y
CONFIG_ESPTOOLPY_FLASHMODE_DIO=y

# Keep enough app space for Arduino WiFi + HTTPClient.
CONFIG_PARTITION_TABLE_CUSTOM=y
CONFIG_PARTITION_TABLE_CUSTOM_FILENAME="partitions.csv"
```
